/* Pin overlay for 2-button macro pad on nRF52840 Supermini (nice!nano pinout)
 * Adjust &gpio0 pin numbers to match YOUR wiring.
 * Defaults: Button 0 → D1 (P0.06), Button 1 → D2 (P0.08)
 * Accent the other leg of each switch to GND.
 */

/ {
    chosen {
        zmk,kscan = &kscan0;
    };

    kscan0: kscan_0 {
        compatible = "zmk,kscan-gpio-direct";
        label = "KSCAN";
        wakeup-source;

        input-gpios =
            <&gpio0 6 (GPIO_ACTIVE_LOW | GPIO_PULL_UP)>,  /* D1 (P0.06) – "I" */
            <&gpio0 8 (GPIO_ACTIVE_LOW | GPIO_PULL_UP)>;  /* D2 (P0.08) – "K" */
    };
};
